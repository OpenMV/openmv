/*
 * Copyright (C) 2025 OpenMV, LLC.
 *
 * Redistribution and use in source and binary forms, with or without
 * modification, are permitted provided that the following conditions
 * are met:
 *
 * 1. Redistributions of source code must retain the above copyright
 *    notice, this list of conditions and the following disclaimer.
 * 2. Redistributions in binary form must reproduce the above copyright
 *    notice, this list of conditions and the following disclaimer in
 *    the documentation and/or other materials provided with the
 *    distribution.
 * 3. Any redistribution, use, or modification in source or binary form
 *    is done solely for personal benefit and not for any commercial
 *    purpose or for monetary gain. For commercial licensing options,
 *    please contact openmv@openmv.io
 *
 * THIS SOFTWARE IS PROVIDED BY THE LICENSOR AND COPYRIGHT OWNER "AS IS"
 * AND ANY EXPRESS OR IMPLIED WARRANTIES, INCLUDING, BUT NOT LIMITED TO,
 * THE IMPLIED WARRANTIES OF MERCHANTABILITY AND FITNESS FOR A PARTICULAR
 * PURPOSE ARE DISCLAIMED. IN NO EVENT SHALL THE LICENSOR OR COPYRIGHT
 * OWNER BE LIABLE FOR ANY DIRECT, INDIRECT, INCIDENTAL, SPECIAL,
 * EXEMPLARY, OR CONSEQUENTIAL DAMAGES (INCLUDING, BUT NOT LIMITED TO,
 * PROCUREMENT OF SUBSTITUTE GOODS OR SERVICES; LOSS OF USE, DATA, OR
 * PROFITS; OR BUSINESS INTERRUPTION) HOWEVER CAUSED AND ON ANY THEORY
 * OF LIABILITY, WHETHER IN CONTRACT, STRICT LIABILITY, OR TORT
 * (INCLUDING NEGLIGENCE OR OTHERWISE) ARISING IN ANY WAY OUT OF THE USE
 * OF THIS SOFTWARE, EVEN IF ADVISED OF THE POSSIBILITY OF SUCH DAMAGE.
 *
 * PixArt PS5520 driver.
 */
#include "omv_boardconfig.h"
#if (OMV_PS5520_ENABLE == 1)

#include <stdint.h>
#include <stdlib.h>
#include <string.h>
#include <stdio.h>

#include "omv_i2c.h"
#include "omv_csi.h"
#include "ps5520.h"
#include "py/mphal.h"

#define REG_BANK                (0xEF)

// Bank #0
#define CMD_OUTGEN              (0xBF)
// Bank #1
#define CMD_LPF_H               (0x0A)
#define CMD_LPF_L               (0x0B)
#define CMD_OFFNY1_H            (0x0C)
#define CMD_OFFNY1_L            (0x0D)
#define CMD_GAIN_IDX            (0x83)
#define CMD_HFLIP               (0x1B)
#define CMD_HSIZE_E1            (0x1C)
#define CMD_VFLIP               (0x1D)
#define R_ISP_TESTMODE          (0x92)
#define SENSOR_UPDATE           (0x09)

#define PIX_CLK                 (160000000)

#define VTS_5M_30               (1980)
#define HTS_5M_30               (2700)
#define FPS_MAX                 (30)
#define CONST1                  (HTS_5M_30 - 1600)
#define ConvertL2T(line)        (((line * HTS_5M_30) + CONST1 + (PIX_CLK / 2000000)) / (PIX_CLK / 1000000))
#define ConvertT2L(t)           ((t * (PIX_CLK / 1000000) - CONST1 + (HTS_5M_30 / 2)) / HTS_5M_30)

#define PS5520_MIN_INT          (1) // ExpLine min vlaue
#define PS5520_MAX_INT          ((VTS_5M_30 - 3)) // ExpLine max vlaue
#define PS5520_MIN_AGAIN_REG    (4)
#define PS5520_MAX_AGAIN_REG    (80)

#define PS5520_GAIN_SCALE       (16)
#define PS5520_GAIN_SCALE_F     (16.0f)

#define PS5520_GAIN(idx)        ((16 + ((idx & 0x0F))) << (idx >> 4))

#define PS5520_WIDTH_ALIGN      (8)
#define PS5520_FPS_MAX          (FPS_MAX)

static const uint8_t default_regs[][2] = {
    // PS5520_2592x1944x30fps_24MHz_2Lane_RAW10_840Mbps_noImgSyn_20190408_C10A.asc
    { 0xEF, 0x05 },
    { 0x0F, 0x00 },
    { 0x43, 0x02 },
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    { 0x00, 0x00 }, // End
};

static const uint8_t default_1296x972_regs[][2] = {
    // PS5520_1296x972x30fps_24MHz_2Lane_RAW10_840Mbps_noImgSyn_20190408_C10A.asc
    { 0xEF, 0x05 },
    { 0x0F, 0x00 },
    { 0x43, 0x02 },
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    { 0x00, 0x00 }, // End
};

static const uint8_t default_648x486_regs[][2] = {
    // PS5520_648x486x30fps_24MHz_2Lane_RAW10_840Mbps_noImgSyn_20190408_C10A.asc
    { 0xEF, 0x05 },
    { 0x0F, 0x00 },
    { 0x43, 0x02 },
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    { 0x00, 0x00 }, // End
};


static const uint8_t default_2560x1440_regs[][2] = {
    // PS5520_2592x1944x30fps_24MHz_2Lane_RAW10_840Mbps_noImgSyn_20190408_C10A.asc
    { 0xEF, 0x05 },
    { 0x0F, 0x00 },
    { 0x43, 0x02 },
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    { 0x00, 0x00 }, // End
};

static const uint8_t default_1920x1080_regs[][2] = {
    // PS5520_2592x1944x30fps_24MHz_2Lane_RAW10_840Mbps_noImgSyn_20190408_C10A.asc
    { 0xEF, 0x05 },
    { 0x0F, 0x00 },
    { 0x43, 0x02 },
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    { 0x00, 0x00 }, // End
};

static const uint8_t default_1280x720_regs[][2] = {
    // PS5520_1296x972x30fps_24MHz_2Lane_RAW10_840Mbps_noImgSyn_20190408_C10A.asc
    { 0xEF, 0x05 },
    { 0x0F, 0x00 },
    { 0x43, 0x02 },
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    { 0x00, 0x00 }, // End
};

static const uint8_t stream_on_regs[][2] = {
    { 0xEF, 0x01 },
    { 0xF5, 0x10 },
    { 0x09, 0x01 },
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    { 0x00, 0x00 }, // End
};

static const uint8_t stream_off_regs[][2] = {
    { 0xEF, 0x05 },
    { 0x0F, 0x00 },
    { 0xED, 0x01 },
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    { 0x00, 0x00 }, // End
};

static const uint8_t sw_reset_regs[][2] = {
    { 0xEF, 0x05 },
    { 0x0F, 0x00 },
    { 0xED, 0x01 },
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    { 0x00, 0x00 }, // End
};

static int reset(omv_csi_t *csi) {
    int ret = 0;
    // Write default registers
    for (int i = 0; default_regs[i][0] && ret == 0; i++) {
        if (default_regs[i][0] == 0xFF) {
            mp_hal_delay_ms(default_regs[i][1]);
        } else {
            ret |= omv_i2c_writeb(&csi->i2c_bus, csi->slv_addr, default_regs[i][0], default_regs[i][1]);
        }
    }
    return ret;
}

static int sleep(omv_csi_t *csi, int enable) {
    int ret = 0;
    const uint8_t(*regs)[2] = enable ? stream_off_regs : stream_on_regs;

    // Write default registers
    for (int i = 0; regs[i][0] && ret == 0; i++) {
        if (regs[i][0] == 0xFF) {
            mp_hal_delay_ms(regs[i][1]);
        } else {
            ret |= omv_i2c_writeb(&csi->i2c_bus, csi->slv_addr, regs[i][0], regs[i][1]);
        }
    }
    return ret;
}

static int read_reg(omv_csi_t *csi, uint16_t reg) {
    uint8_t reg_data;
    if (omv_i2c_readb(&csi->i2c_bus, csi->slv_addr, reg, &reg_data) != 0) {
        return -1;
    }
    return reg_data;
}

static int write_reg(omv_csi_t *csi, uint16_t reg, uint16_t reg_data) {
    return omv_i2c_writeb(&csi->i2c_bus, csi->slv_addr, reg, reg_data);
}

static __attribute__((unused)) int read_reg_seq(omv_csi_t *csi, uint16_t addr, size_t size, uint8_t *buf) {
    int ret = 0;
    for (size_t i = 0; i < size; i++) {
        ret |= omv_i2c_readb(&csi->i2c_bus, csi->slv_addr, addr + i, &buf[i]);
    }
    return ret;
}

static int set_pixformat(omv_csi_t *csi, pixformat_t pixformat) {
    switch (pixformat) {
        case PIXFORMAT_RGB565:
        case PIXFORMAT_BAYER:
        case PIXFORMAT_GRAYSCALE:
            return 0;
        default:
            return -1;
    }
}

static int set_framesize(omv_csi_t *csi, omv_csi_framesize_t framesize) {
    int ret = 0;
    const uint8_t(*regs)[2];

    switch (framesize) {
        case OMV_CSI_FRAMESIZE_WQXGA2:
            regs = default_regs;
            break;
        case OMV_CSI_FRAMESIZE_SXGAM:
            regs = default_1296x972_regs;
            break;
        case OMV_CSI_FRAMESIZE_VGA:
            regs = default_648x486_regs;
            break;
        case OMV_CSI_FRAMESIZE_QHD: // 2560x1440
            regs = default_2560x1440_regs;
            break;
        case OMV_CSI_FRAMESIZE_FHD: // 1920x1080
            regs = default_1920x1080_regs;
            break;
        case OMV_CSI_FRAMESIZE_HD:  // 1280x720
            regs = default_1280x720_regs;
            break;
        default:
            return -1;
    }

    // SW reset
    for (int i = 0; regs[i][0] && ret == 0; i++) {
        ret |= omv_i2c_writeb(&csi->i2c_bus, csi->slv_addr, sw_reset_regs[i][0], sw_reset_regs[i][1]);
    }
    // Set resolution
    for (int i = 0; regs[i][0] && ret == 0; i++) {
        ret |= omv_i2c_writeb(&csi->i2c_bus, csi->slv_addr, regs[i][0], regs[i][1]);
    }

    return ret;
}

static int set_framerate(omv_csi_t *csi, int framerate) {
    int ret = 0;
    int16_t lpf;
    uint8_t exposure_line_h;
    uint8_t exposure_line_l;

    switch (csi->framesize) {
        case OMV_CSI_FRAMESIZE_WQXGA2:
            framerate = IM_MIN(framerate, PS5520_FPS_MAX);
            break;
        default:
            return -1;
    }

    ret |= omv_i2c_writeb(&csi->i2c_bus, csi->slv_addr, REG_BANK, 0x01);

    ret |= omv_i2c_readb(&csi->i2c_bus, csi->slv_addr, CMD_LPF_H, &exposure_line_h);
    ret |= omv_i2c_readb(&csi->i2c_bus, csi->slv_addr, CMD_LPF_L, &exposure_line_l);
    lpf = (exposure_line_h << 8) + exposure_line_l;

    ret |= omv_i2c_readb(&csi->i2c_bus, csi->slv_addr, CMD_OFFNY1_H, &exposure_line_h);
    ret |= omv_i2c_readb(&csi->i2c_bus, csi->slv_addr, CMD_OFFNY1_L, &exposure_line_l);

    int16_t exposure_line = lpf - ((exposure_line_h << 8) + exposure_line_l);

    lpf = (PIX_CLK / HTS_5M_30) / framerate;
    lpf = IM_CLAMP(lpf, VTS_5M_30, 0x10000);

    exposure_line = IM_CLAMP(exposure_line, PS5520_MIN_INT, (lpf - 3));

    ret |= omv_i2c_writeb(&csi->i2c_bus, csi->slv_addr, CMD_LPF_H, (lpf - 1) >> 8);
    ret |= omv_i2c_writeb(&csi->i2c_bus, csi->slv_addr, CMD_LPF_L, (lpf - 1) & 0xFF);

    ret |= omv_i2c_writeb(&csi->i2c_bus, csi->slv_addr, CMD_OFFNY1_H, (lpf - 1 - exposure_line) >> 8);
    ret |= omv_i2c_writeb(&csi->i2c_bus, csi->slv_addr, CMD_OFFNY1_L, (lpf - 1 - exposure_line) & 0xFF);

    ret |= omv_i2c_writeb(&csi->i2c_bus, csi->slv_addr, SENSOR_UPDATE, 0x01);
    return ret;
}

static int set_gainceiling(omv_csi_t *csi, omv_csi_gainceiling_t gainceiling) {
    int ret = -1; // No AGC function of PS5520

    return ret;
}

static int set_colorbar(omv_csi_t *csi, int enable) {
    int ret = 0;
    uint8_t reg;

    ret |= omv_i2c_writeb(&csi->i2c_bus, csi->slv_addr, REG_BANK, 0x00);
    ret |= omv_i2c_readb(&csi->i2c_bus, csi->slv_addr, CMD_OUTGEN, &reg);

    reg = enable ? (reg | 0x60) : (reg & 0x8F);
    ret |= omv_i2c_writeb(&csi->i2c_bus, csi->slv_addr, CMD_OUTGEN, reg);
    ret |= omv_i2c_writeb(&csi->i2c_bus, csi->slv_addr, REG_BANK, 0x01);
    ret |= omv_i2c_readb(&csi->i2c_bus, csi->slv_addr, R_ISP_TESTMODE, &reg);

    reg = enable ? (reg | 0x06) : (reg & 0xE0);
    ret |= omv_i2c_writeb(&csi->i2c_bus, csi->slv_addr, R_ISP_TESTMODE, reg);
    ret |= omv_i2c_writeb(&csi->i2c_bus, csi->slv_addr, SENSOR_UPDATE, 0x01);

    return ret;
}

static int set_auto_gain(omv_csi_t *csi, int enable, float gain_db, float gain_db_ceiling) {
    int gain = 0;
    int idx = 0;
    int ret = omv_i2c_writeb(&csi->i2c_bus, csi->slv_addr, REG_BANK, 0x01);

    if (enable == 0) {
        if ((!isnanf(gain_db)) && (!isinff(gain_db))) {
            gain = fast_roundf(expf((gain_db / 20.0f) * M_LN10) * PS5520_GAIN_SCALE_F);
        } else if ((!isnanf(gain_db_ceiling)) && (!isinff(gain_db_ceiling))) {
            gain = fast_roundf(expf((gain_db_ceiling / 20.0f) * M_LN10) * PS5520_GAIN_SCALE_F);
        }

        for (idx = 0; gain >> (4 + idx); idx++) {

        }

        idx = idx - 1;
        gain = ((idx - 1) << 4) + ((gain >> (idx - 1)) & 0x0F);
        gain = IM_CLAMP(gain, PS5520_MIN_AGAIN_REG, PS5520_MAX_AGAIN_REG);

        ret |= omv_i2c_writeb(&csi->i2c_bus, csi->slv_addr, CMD_GAIN_IDX, gain);
        ret |= omv_i2c_writeb(&csi->i2c_bus, csi->slv_addr, SENSOR_UPDATE, 0x01);
    } else {
        ret = -1;   // No AGC function of PS5520
    }

    return ret;
}

static int get_gain_db(omv_csi_t *csi, float *gain_db) {
    uint8_t gain;
    int ret = omv_i2c_writeb(&csi->i2c_bus, csi->slv_addr, REG_BANK, 0x01);

    ret |= omv_i2c_readb(&csi->i2c_bus, csi->slv_addr, CMD_GAIN_IDX, &gain);

    *gain_db = 20.0f * log10f(PS5520_GAIN((int) gain) / PS5520_GAIN_SCALE_F);

    return ret;
}

static int set_auto_exposure(omv_csi_t *csi, int enable, int exposure_us) {
    int ret = 0;
    int16_t lpf;
    uint8_t exposure_line_h;
    uint8_t exposure_line_l;

    if ((enable == 0) && (exposure_us > 0)) {
        ret |= omv_i2c_writeb(&csi->i2c_bus, csi->slv_addr, REG_BANK, 0x01);

        ret |= omv_i2c_readb(&csi->i2c_bus, csi->slv_addr, CMD_LPF_H, &exposure_line_h);
        ret |= omv_i2c_readb(&csi->i2c_bus, csi->slv_addr, CMD_LPF_L, &exposure_line_l);
        lpf = (exposure_line_h << 8) + exposure_line_l;

        int16_t exposure_line = ConvertT2L(exposure_us);

        exposure_line = IM_CLAMP(exposure_line, PS5520_MIN_INT, (lpf - 3));

        ret |= omv_i2c_writeb(&csi->i2c_bus, csi->slv_addr, CMD_OFFNY1_H, (lpf - 1 - exposure_line) >> 8);
        ret |= omv_i2c_writeb(&csi->i2c_bus, csi->slv_addr, CMD_OFFNY1_L, (lpf - 1 - exposure_line) & 0xFF);

        ret |= omv_i2c_writeb(&csi->i2c_bus, csi->slv_addr, SENSOR_UPDATE, 0x01);
    } else {
        ret = -1;   // No AEC function of PS5520
    }

    return ret;
}

static int get_exposure_us(omv_csi_t *csi, int *exposure_us) {
    int ret = 0;
    uint16_t lpf;
    uint8_t exposure_line_h;
    uint8_t exposure_line_l;

    ret |= omv_i2c_writeb(&csi->i2c_bus, csi->slv_addr, REG_BANK, 0x01);

    ret |= omv_i2c_readb(&csi->i2c_bus, csi->slv_addr, CMD_LPF_H, &exposure_line_h);
    ret |= omv_i2c_readb(&csi->i2c_bus, csi->slv_addr, CMD_LPF_L, &exposure_line_l);
    lpf = (exposure_line_h << 8) + exposure_line_l;

    ret |= omv_i2c_readb(&csi->i2c_bus, csi->slv_addr, CMD_OFFNY1_H, &exposure_line_h);
    ret |= omv_i2c_readb(&csi->i2c_bus, csi->slv_addr, CMD_OFFNY1_L, &exposure_line_l);

    int16_t exposure_line = lpf - ((exposure_line_h << 8) + exposure_line_l);
    *exposure_us = ConvertL2T(exposure_line);

    return ret;
}

static int set_hmirror(omv_csi_t *csi, int enable) {
    uint8_t reg1, reg2;
    uint16_t hsize;

    int ret = omv_i2c_writeb(&csi->i2c_bus, csi->slv_addr, REG_BANK, 0x01);
    ret |= omv_i2c_readb(&csi->i2c_bus, csi->slv_addr, CMD_HFLIP, &reg1);
    ret |= omv_i2c_readb(&csi->i2c_bus, csi->slv_addr, CMD_HSIZE_E1, &reg2);

    hsize = ((reg1 & 0x7F) << 8) + reg2 - (reg1 >> 7) + (enable?0x7FFF:0);
    reg1 = hsize >> 8;
    reg2 = hsize & 0xFF;
    ret |= omv_i2c_writeb(&csi->i2c_bus, csi->slv_addr, CMD_HFLIP, reg1);
    ret |= omv_i2c_writeb(&csi->i2c_bus, csi->slv_addr, CMD_HSIZE_E1, reg2);
    ret |= omv_i2c_writeb(&csi->i2c_bus, csi->slv_addr, SENSOR_UPDATE, 0x01);

    return ret;
}

static int set_vflip(omv_csi_t *csi, int enable) {
    uint8_t reg1;

    int ret = omv_i2c_writeb(&csi->i2c_bus, csi->slv_addr, REG_BANK, 0x01);
    ret |= omv_i2c_readb(&csi->i2c_bus, csi->slv_addr, CMD_VFLIP, &reg1);

    ret |= omv_i2c_writeb(&csi->i2c_bus, csi->slv_addr, CMD_VFLIP, (reg1 & 0x7F) | ((enable & 0x01) << 7));
    ret |= omv_i2c_writeb(&csi->i2c_bus, csi->slv_addr, SENSOR_UPDATE, 0x01);

    return ret;
}

static int ioctl(omv_csi_t *csi, int request, va_list ap) {
    int ret = 0;

    return ret;
}

int ps5520_init(omv_csi_t *csi) {
    // Initialize csi flags.
    csi->vsync_pol = 0;
    csi->hsync_pol = 0;
    csi->pixck_pol = 1;
    csi->mono_bpp = 1;
    csi->raw_output = 1;
    csi->cfa_format = SUBFORMAT_ID_BGGR;
    csi->mipi_if = 1;
    csi->mipi_brate= 850;

    // Initialize csi ops.
    csi->reset = reset;
    csi->sleep = sleep;
    csi->ioctl = ioctl;
    csi->read_reg = read_reg;
    csi->write_reg = write_reg;
    csi->set_pixformat = set_pixformat;
    csi->set_framesize = set_framesize;
    csi->set_framerate = set_framerate;
    csi->set_gainceiling = set_gainceiling;
    csi->set_colorbar = set_colorbar;
    csi->set_auto_gain = set_auto_gain;
    csi->get_gain_db = get_gain_db;
    csi->set_auto_exposure = set_auto_exposure;
    csi->get_exposure_us = get_exposure_us;
    csi->set_hmirror = set_hmirror;
    csi->set_vflip = set_vflip;

    // Override standard resolutions
    resolution[OMV_CSI_FRAMESIZE_WQXGA2][0] = 2592;
    resolution[OMV_CSI_FRAMESIZE_WQXGA2][1] = 1944;

    return 0;
}
#endif // (OMV_PS5520_ENABLE == 1)
